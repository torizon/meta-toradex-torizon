## conf/distro/include/torizon-secondaries.inc
```bitbake
# Per-machine defaults for the secondaries aktualizr-default-sec registers ("1") or not ("0"),
# matching what each machine has registered so far. A new machine's configuration sets
# TORIZON_SECONDARY_* with "?=" (a plain assignment there would override local.conf). Torizon Cloud
# accepts a new ECU later, but rejects one that disappears and returns.

# Toradex machines
TORIZON_SECONDARY_BOOTLOADER_DEFAULT:apalis-imx6 = "1"
TORIZON_SECONDARY_FUSES_DEFAULT:apalis-imx6 = "1"
TORIZON_SECONDARY_BOOTLOADER_DEFAULT:apalis-imx8 = "1"
TORIZON_SECONDARY_FUSES_DEFAULT:apalis-imx8 = "1"
TORIZON_SECONDARY_BOOTLOADER_DEFAULT:aquila-am69 = "1"
TORIZON_SECONDARY_BOOTLOADER_DEFAULT:aquila-imx95 = "1"
TORIZON_SECONDARY_FUSES_DEFAULT:aquila-imx95 = "1"
TORIZON_SECONDARY_BOOTLOADER_DEFAULT:colibri-imx6 = "1"
TORIZON_SECONDARY_FUSES_DEFAULT:colibri-imx6 = "1"
TORIZON_SECONDARY_BOOTLOADER_DEFAULT:colibri-imx6ull-emmc = "1"
TORIZON_SECONDARY_FUSES_DEFAULT:colibri-imx6ull-emmc = "1"
TORIZON_SECONDARY_BOOTLOADER_DEFAULT:colibri-imx7-emmc = "1"
TORIZON_SECONDARY_FUSES_DEFAULT:colibri-imx7-emmc = "1"
TORIZON_SECONDARY_BOOTLOADER_DEFAULT:colibri-imx8x = "1"
TORIZON_SECONDARY_FUSES_DEFAULT:colibri-imx8x = "1"
TORIZON_SECONDARY_BOOTLOADER_DEFAULT:genericx86-64 = "1"
TORIZON_SECONDARY_BOOTLOADER_DEFAULT:lino-imx93 = "1"
TORIZON_SECONDARY_FUSES_DEFAULT:lino-imx93 = "1"
TORIZON_SECONDARY_BOOTLOADER_DEFAULT:qemuarm64 = "1"
TORIZON_SECONDARY_BOOTLOADER_DEFAULT:toradex-osm-imx93 = "1"
TORIZON_SECONDARY_FUSES_DEFAULT:toradex-osm-imx93 = "1"
TORIZON_SECONDARY_BOOTLOADER_DEFAULT:toradex-smarc-imx8mp = "1"
TORIZON_SECONDARY_FUSES_DEFAULT:toradex-smarc-imx8mp = "1"
TORIZON_SECONDARY_BOOTLOADER_DEFAULT:toradex-smarc-imx95 = "1"
TORIZON_SECONDARY_FUSES_DEFAULT:toradex-smarc-imx95 = "1"
TORIZON_SECONDARY_BOOTLOADER_DEFAULT:verdin-am62 = "1"
TORIZON_SECONDARY_BOOTLOADER_DEFAULT:verdin-am62p = "1"
TORIZON_SECONDARY_BOOTLOADER_DEFAULT:verdin-imx8mm = "1"
TORIZON_SECONDARY_FUSES_DEFAULT:verdin-imx8mm = "1"
TORIZON_SECONDARY_BOOTLOADER_DEFAULT:verdin-imx8mp = "1"
TORIZON_SECONDARY_FUSES_DEFAULT:verdin-imx8mp = "1"
TORIZON_SECONDARY_BOOTLOADER_DEFAULT:verdin-imx95 = "1"
TORIZON_SECONDARY_FUSES_DEFAULT:verdin-imx95 = "1"

# Common Torizon machines
TORIZON_SECONDARY_BOOTLOADER_DEFAULT:am62lxx-evm = "1"
TORIZON_SECONDARY_BOOTLOADER_DEFAULT:am62pxx-evm = "1"
TORIZON_SECONDARY_BOOTLOADER_DEFAULT:am62xx-evm = "1"
TORIZON_SECONDARY_BOOTLOADER_DEFAULT:beagley-ai = "1"
TORIZON_SECONDARY_BOOTLOADER_DEFAULT:imx6sxsabresd = "1"
TORIZON_SECONDARY_FUSES_DEFAULT:imx6sxsabresd = "1"
TORIZON_SECONDARY_BOOTLOADER_DEFAULT:imx93frdm = "1"
TORIZON_SECONDARY_FUSES_DEFAULT:imx93frdm = "1"
TORIZON_SECONDARY_BOOTLOADER_DEFAULT:imx95-19x19-verdin = "1"
TORIZON_SECONDARY_FUSES_DEFAULT:imx95-19x19-verdin = "1"
TORIZON_SECONDARY_BOOTLOADER_DEFAULT:intel-corei7-64 = "1"
TORIZON_SECONDARY_BOOTLOADER_DEFAULT:jetson-orin-nano-devkit = "1"
TORIZON_SECONDARY_BOOTLOADER_DEFAULT:jetson-orin-nano-devkit-nvme = "1"
TORIZON_SECONDARY_BOOTLOADER_DEFAULT:lec-mtk-i1200-ufs = "1"
TORIZON_SECONDARY_BOOTLOADER_DEFAULT:luna-sl1680 = "1"
TORIZON_SECONDARY_BOOTLOADER_DEFAULT:sl1680 = "1"
TORIZON_SECONDARY_BOOTLOADER_DEFAULT:sl2619 = "1"
TORIZON_SECONDARY_BOOTLOADER_DEFAULT:smarc-rzv2l = "1"
TORIZON_SECONDARY_BOOTLOADER_DEFAULT:stm32mp15-disco = "1"
TORIZON_SECONDARY_BOOTLOADER_DEFAULT:stm32mp25-disco = "1"
TORIZON_SECONDARY_BOOTLOADER_DEFAULT:stm32mp25-eval = "1"

# Machines where bootloader updates are officially supported (handler "uboot-emmc"); every other
# machine gets the "dummy" handler, which keeps the secondary but refuses updates.
BOOTLOADER_ACTION_HANDLER_TYPE_DEFAULT:apalis-imx6 = "uboot-emmc"
BOOTLOADER_ACTION_HANDLER_TYPE_DEFAULT:apalis-imx8 = "uboot-emmc"
BOOTLOADER_ACTION_HANDLER_TYPE_DEFAULT:colibri-imx6 = "uboot-emmc"
BOOTLOADER_ACTION_HANDLER_TYPE_DEFAULT:colibri-imx6ull-emmc = "uboot-emmc"
BOOTLOADER_ACTION_HANDLER_TYPE_DEFAULT:colibri-imx7-emmc = "uboot-emmc"
BOOTLOADER_ACTION_HANDLER_TYPE_DEFAULT:colibri-imx8x = "uboot-emmc"
BOOTLOADER_ACTION_HANDLER_TYPE_DEFAULT:verdin-am62 = "uboot-emmc"
BOOTLOADER_ACTION_HANDLER_TYPE_DEFAULT:verdin-am62p = "uboot-emmc"
BOOTLOADER_ACTION_HANDLER_TYPE_DEFAULT:verdin-imx8mm = "uboot-emmc"
BOOTLOADER_ACTION_HANDLER_TYPE_DEFAULT:verdin-imx8mp = "uboot-emmc"
```

## conf/machine/include/intel-corei7-64.inc
```bitbake
WKS_FILE:intel-corei7-64:sota = "efiimage-sota.wks"
WKS_FILE:intel-corei7-64:sota:tdx-signed = "efiimage-sota-signed.wks"
WKS_FILE_DEPENDS:remove = "tezi-metadata virtual/dtb"

OSTREE_KERNEL_ARGS:sota:append:intel-corei7-64 = "console=ttyS0,115200 root=LABEL=otaroot rootfstype=ext4 quiet logo.nologo vt.global_cursor_default=0 plymouth.ignore-serial-consoles splash fbcon=map:10 systemd.gpt_auto=0 "

XENOMAI_KERNEL_ARGS = "audit=0 hpet=disable clocksource=tsc tsc=reliable intel_pstate=disable intel_idle.max_cstate=0 intel.max_cstate=0 processor.max_cstate=0 processor_idle.max_cstate=0 \
                    rcupdate.rcu_cpu_stall_suppress=1 mce=off nmi_watchdog=0 nosoftlockup noht numa_balancing=disable hugepages=1024 rcu_nocb_poll=1024 irqaffinity=0 isolcpus=1,3 rcu_nocbs=1,3 nohz_full=1,3 \
                    i915.enable_rc6=0 i915.enable_dc=0 i915.disable_power_well=0 "
OSTREE_KERNEL_ARGS:sota:append:intel-corei7-64:xenomai3 = " ${XENOMAI_KERNEL_ARGS} "
OSTREE_KERNEL_ARGS:sota:append:intel-corei7-64:xenomai4 = " ${XENOMAI_KERNEL_ARGS} "

OSTREE_BOOTLOADER:intel-corei7-64 = "grub"
OSTREE_BOOTLOADER:intel-corei7-64:tdx-signed = "systemd-boot"
OSTREE_DEPLOY_DEVICETREE:intel-corei7-64 = "0"
EFI_PROVIDER:intel-corei7-64 = "grub-efi"
EFI_PROVIDER:intel-corei7-64:tdx-signed = "systemd-boot"
SOTA_CLIENT_FEATURES:remove = "ubootenv"
UBOOT_BINARY_OTA_IGNORE:intel-corei7-64 = "1"

IMAGE_FSTYPES_REMOVE = "hddimg teziimg"
IMAGE_FSTYPES:append = " wic.vmdk wic.vdi"

hostname:pn-base-files = "torizon-x86"

PREFERRED_PROVIDER_u-boot-default-script = ""
PREFERRED_PROVIDER_virtual/dtb = ""

PREFERRED_PROVIDER_virtual/kernel:intel-corei7-64 = "linux-yocto"
PREFERRED_VERSION_linux-yocto:intel-corei7-64 ?= "6.6%"

PREFERRED_PROVIDER_virtual/kernel:xenomai3 = "linux-xenomai-3"
PREFERRED_VERSION_linux-xenomai-3 ?= "5.10.%"

PREFERRED_PROVIDER_virtual/kernel:xenomai4 = "linux-xenomai-4"
PREFERRED_VERSION_linux-xenomai-4 = "5.10.%"

IMAGE_INSTALL:append = " grub-ota-fallback"
IMAGE_INSTALL:remove:tdx-signed = "grub-ota-fallback"
IMAGE_INSTALL:remove = " minnowboard-efi-startup network-configuration"
# Default linux-yocto inherits toradex-kernel-localversion (KERNEL_LOCALVERSION
# = -${TDX_VERSION}); these extensions apply only to the xenomai kernels.
LINUX_VERSION_EXTENSION:xenomai3 ?= "-torizon-${LINUX_KERNEL_TYPE}-xenomai3"
LINUX_VERSION_EXTENSION:xenomai4 ?= "-torizon-${LINUX_KERNEL_TYPE}-xenomai4"

# Enable OVMF Secure Boot build (produces ovmf.secboot.fd + EnrollDefaultKeys.efi)
PACKAGECONFIG:append:pn-ovmf = " secureboot"

PACKAGECONFIG:append:pn-systemd:tdx-signed = " efi"

# Expose TPM2 to OVMF (auto-enables -D TPM_ENABLE=TRUE in the OVMF build)
MACHINE_FEATURES:append = " tpm2"

IMAGE_EFI_BOOT_FILES:tdx-signed = " \
    systemd-bootx64.signed.efi;EFI/BOOT/bootx64.efi \
    loader/keys/auto/PK.auth \
    loader/keys/auto/KEK.auth \
    loader/keys/auto/db.auth \
    loader/keys/auto/dbx.auth \
    "
```

## conf/machine/include/sl1680.inc
```bitbake
OSTREE_KERNEL_ARGS:append:sota = " console=ttyS0,115200 earlycon root=LABEL=otaroot rootfstype=ext4 cma=524288000@1556086784"

DISTRO_FEATURES:append = " tpm2"

IMAGE_INSTALL:append = " \
    imgtec-pvr-firmware \
    kernel-module-bluetooth-lpm \
    kernel-module-bluetooth-rfkill \
    kernel-module-hl7593 \
    kernel-module-hrx-v4l2 \
    kernel-module-pvrsrvkm \
    kernel-module-rpi-panel-attiny-regulator \
    linux-firmware-syna \
    optee-client \
    optee-examples \
    optee-os-tadevkit \
    optee-test \
    pciutils \
    synasdk-brcm-bt-start \
    synasdk-drm-factory-ca-program \
    synasdk-factory-ta \
    synasdk-macaddr \
    synasdk-synap-module \
    synasdk-v4l2isp-daemon \
    synasdk-vpu-plugin \
    syna-wifi-tools \
"

SYNA_SDK_CONFIG_NAME = "sl1680_poky_aarch64_rdk"
SYNA_SDK_CONFIG_FILE = "sl1680_poky_aarch64_rdk_defconfig"

UBOOT_BOOT_PARTITION_NUMBER = "6"

hostname:pn-base-files = "torizon-sl1680"

DISTRO_FEATURES_REMOVE:remove = "vulkan"

require sl-common.inc

do_image_ota_ext4[depends] += "syna2img-tools:do_deploy"
```

## conf/machine/include/sl2619.inc
```bitbake
OSTREE_KERNEL_ARGS:append:sota = " console=ttyS0,115200 earlycon root=LABEL=otaroot rootfstype=ext4"

SYNA_SDK_CONFIG_NAME = "sl2619_poky_aarch64_rdk"
SYNA_SDK_CONFIG_FILE = "sl2619_poky_aarch64_rdk_defconfig"

UBOOT_BOOT_PARTITION_NUMBER = "8"

hostname:pn-base-files = "torizon-sl2619"

MACHINE_EXTRA_RRECOMMENDS:remove = "synasdk-gpu-mali"

require sl-common.inc
```
