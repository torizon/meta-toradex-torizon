## conf/distro/common-torizon-xenomai3.conf
```bitbake
require conf/distro/common-torizon.conf

DISTRO = "common-torizon-xenomai3"
DISTRO_NAME = "Common Torizon OS with Xenomai 3"

DISTRO_FLAVOUR = " (XENOMAI3)"
DISTRO_FLAVOUR:experimental = " (XENOMAI3 EXPERIMENTAL)"

DISTROOVERRIDES .= ":xenomai3"

IMAGE_BASENAME_SUFFIX = "-xenomai3"
```

## conf/distro/common-torizon-xenomai4.conf
```bitbake
require conf/distro/common-torizon.conf

DISTRO = "common-torizon-xenomai4"
DISTRO_NAME = "Common Torizon OS with Xenomai 4"

DISTRO_FLAVOUR = " (XENOMAI4)"
DISTRO_FLAVOUR:experimental = " (XENOMAI4 EXPERIMENTAL)"

DISTROOVERRIDES .= ":xenomai4"

IMAGE_BASENAME_SUFFIX = "-xenomai4"
```

## conf/distro/common-torizon.conf
```bitbake
require conf/distro/include/common-torizon.inc
require conf/distro/sota.conf.inc

DISTRO = "common-torizon"
DISTRO_NAME = "Common Torizon OS"

DISTRO_FLAVOUR:experimental = " (EXPERIMENTAL)"
```

## conf/distro/include/base-distro.inc
```bitbake
MAINTAINER = "Toradex Torizon OS Team <torizon.os@toradex.com>"

TCLIBCAPPEND = ""

COPY_LIC_MANIFEST = "1"
COPY_LIC_DIRS = "1"

IMAGE_BASENAME_SUFFIX ?= ""

IMX_DEFAULT_BSP = "nxp"
IMX_DEFAULT_BSP:upstream = "mainline"

SDK_NAME_PREFIX = "${DISTRO}"
SDK_VERSION = "${DISTRO_VERSION}"

IMAGE_CLASSES:remove = "image_types_fsl"

# Torizon machine specific overrides
INHERIT += "torizon"

# This also disables the static packageconfig. runc needs to be dynamically
# linked for seccomp support. https://github.com/opencontainers/runc/issues/2008
PACKAGECONFIG:remove:pn-${PREFERRED_PROVIDER_virtual/runc} = "static"
PACKAGECONFIG:append:pn-${PREFERRED_PROVIDER_virtual/runc} = " seccomp"
PACKAGECONFIG:append:pn-${PREFERRED_PROVIDER_virtual/docker} = " seccomp"
PACKAGECONFIG:append:pn-systemd = " seccomp"

# SOTA
GARAGE_SIGN_TOOL = "uptane-sign"
OSTREE_OSNAME = "torizon"
OSTREE_MULTI_DEVICETREE_SUPPORT = "1"
SOTA_CLIENT_FEATURES:append = " ubootenv"
INITRAMFS_IMAGE = "initramfs-ostree-torizon-image"
INITRAMFS_FSTYPES = "cpio.gz"
BUILD_OSTREE_TARBALL = "0"
IMAGE_FSTYPES:remove:sota = "${IMAGE_FSTYPES_REMOVE}"

# No need to install boot script, kernel image, devicetrees or firmware into the boot partition
IMAGE_BOOT_FILES = ""
IMAGE_BOOT_FILES_REMOVE:sota = "boot.scr-${MACHINE};boot.scr overlays.txt overlays/*;overlays/"
IMAGE_BOOT_FILES_REMOVE:append:apalis-imx8 = " hdmitxfw.bin dpfw.bin"

DISTRO_FEATURES:append = " virtualization stateless-system"
DISTRO_FEATURES_REMOVE ?= "3g alsa irda pcmcia nfc ldconfig pulseaudio wayland x11 ptest multiarch vulkan"
DISTRO_FEATURES_REMOVE:remove:verdin-imx95 = "vulkan"
DISTRO_FEATURES_REMOVE:remove:toradex-smarc-imx95 = "vulkan"
DISTRO_FEATURES_REMOVE:append:imx-generic-bsp = " opengl"
DISTRO_FEATURES:remove = "${DISTRO_FEATURES_REMOVE}"

# No need for x11 even for native
DISTRO_FEATURES_NATIVE:remove:imx-generic-bsp = "x11"
DISTRO_FEATURES_NATIVESDK:remove:imx-generic-bsp = "x11"

# Note, enable or disable the useradd-staticids in a configured system,
# the TMPDIR/DEPLOY_DIR/SSTATE_DIR may contain incorrect uid/gid values.
# Clearing them will correct this condition.
USERADDEXTENSION = "useradd-staticids"
USERADD_UID_TABLES = "files/torizon-static-passwd"
USERADD_GID_TABLES = "files/torizon-static-group"
USERADD_ERROR_DYNAMIC = "skip"

BBMASK += " \
    /meta-freescale/recipes-graphics/cairo \
"

# machines where Torizon is experimental
EXPERIMENTALOVERRIDES = ""
# Currently Torizon does not support any experimental machines, in future such machines can be added like below:
#EXPERIMENTALOVERRIDES:colibri-imx6ull = ":experimental"
DISTROOVERRIDES .= "${EXPERIMENTALOVERRIDES}"

# Use our variant of the aktualizr client instead of the
# default from meta-updater
PREFERRED_PROVIDER_aktualizr = "aktualizr-torizon"
PREFERRED_PROVIDER_aktualizr-native = "aktualizr-torizon-native"
PREFERRED_RPROVIDER_aktualizr = "aktualizr-torizon"
PREFERRED_RPROVIDER_aktualizr-info = "aktualizr-torizon"
PREFERRED_RPROVIDER_aktualizr-shared-prov = "aktualizr-torizon"

# disable warning message from meta-security
SKIP_META_SECURITY_SANITY_CHECK = "1"

# Configure the "kernel command-line protection" for Torizon OS (relevant when
# the tdx-signed class is in use).
TOS_SECBOOT_REQUIRED_BOOTARGS_COMMON ?= "root=LABEL=otaroot rootfstype=ext4 ${OSTREE_KERNEL_ARGS}"
TOS_SECBOOT_REQUIRED_BOOTARGS ?= "${TOS_SECBOOT_REQUIRED_BOOTARGS_COMMON}"
TOS_SECBOOT_REQUIRED_BOOTARGS:qemuarm64 ?= ""
# Override BSP configuration:
TDX_SECBOOT_REQUIRED_BOOTARGS:tdx-signed = "${TOS_SECBOOT_REQUIRED_BOOTARGS}"
```

## conf/distro/include/common-torizon.inc
```bitbake
require conf/distro/poky.conf
require base-distro.inc

IMAGE_CLASSES:append = " image_type_common_torizon"

# Override shared by all torizon distros
DISTROOVERRIDES .= ":common-torizon-distro"

# We do not need teziimg, ota-ext4 or wic images by default
IMAGE_FSTYPES_REMOVE ?= "wic.gz wic.bmap wic.xz"
BBMASK += " \
    /meta-arm/recipes-test/pacbti/test-pacbti.bb \
"

OSTREE_DEPLOY_DEVICETREE = "0"

require conf/distro/include/versioning.inc

SDK_VENDOR = "-tznsdk"
SDK_NAME_PREFIX = "${DISTRO}"
# do not use elements in SDK_VERSION which are in vardepsexclude
SDK_VERSION = "${TDX_RELEASE}"

TARGET_VENDOR = "-tzn"

# create etc/build in the rootfs
INHERIT += "image-buildinfo"

# Log information on images and packages
INHERIT += "buildhistory"
BUILDHISTORY_COMMIT = "1"

IMAGE_LINGUAS ?= "en-us"

# Some Toradex recipes like linux-toradex, u-boot-toradex,
# device-tree-overlays are appending SCM hashes to PV, version
# numbers going backwards are not a problem as we don't provide
# binary feeds.
#
# This avoids some annoying errors as follows:
# | QA Issue: Package version went backwards which would break package feeds
ERROR_QA:remove = "version-going-backwards"

DISTRO_FEATURES:append = " pam systemd usrmerge"
DISTRO_FEATURES:remove = "sysvinit ptest"
VIRTUAL-RUNTIME_init_manager = "systemd"
PACKAGECONFIG:append:pn-systemd = " serial-getty-generator"
PACKAGECONFIG:append:pn-qemu-native = " libusb"

PREFERRED_RPROVIDER_network-configuration = "networkmanager"

# keep the dtb vendor directories in fitimage node names
KERNEL_DTBVENDORED = "1"

# Defines the root home directory as /root, as required by systemd.
ROOT_HOME = "/root"

# This function changes the default tune for machines which
# are based on armv7a or armv7ve to use common tune value, note
# that we enforce hard-float which is default on Linux microPlatform.
# If you have one of those machines which are armv7a or armv7ve but
# can't support hard-float, please change tune = 'armv7athf' to
# tune = 'armv7at' below but then this is for your own distro.

def at_least_one(elements, list):
    for i in list:
        if i in elements:
            return True
    return False

def arm_tune_handler(d):
    armv7athf_tune_features = ['armv7a', 'armv7ve', 'cortexa5', 'cortexa7', 'cortexa9', 'cortexa15']
    armv8a_tune_features = ['armv8a', 'crc']
    features = d.getVar('TUNE_FEATURES').split()
    if at_least_one(armv7athf_tune_features, features):
        tune = 'armv7athf'
        if 'bigendian' in features:
            tune += 'b'
        if 'vfpv3' in features:
            tune += '-vfpv3'
        if 'vfpv3d16' in features:
            tune += '-vfpv3d16'
        if 'neon' in features:
            tune += '-neon'
        if 'vfpv4' in features:
            tune += '-vfpv4'
    elif at_least_one(armv8a_tune_features, features):
        # all currently used i.MX 8 members support the following
        tune = 'armv8a-crypto'
    else:
        tune = d.getVar('DEFAULTTUNE')
    return tune

DEFAULTTUNE:tzn := "${@arm_tune_handler(d)}"
```

## conf/distro/include/torizon.inc
```bitbake
require conf/distro/include/tdx-base.inc
require base-distro.inc

IMAGE_CLASSES:append = " image_type_torizon"
IMAGE_CLASSES:remove = "image_type_tezi"

# Override shared by all torizon distros
DISTROOVERRIDES .= ":torizon-distro"

# Toradex specific classes
INHERIT += "toradex-sanity toradex-mirrors"

# We do not need teziimg, ota-ext4 or wic images by default
IMAGE_FSTYPES_REMOVE ?= "ota-ext4 wic wic.gz wic.bmap wic.xz"

# Compatibility with toradex layers
BBMASK += " \
    /meta-toradex-bsp-common/recipes-core/systemd/systemd_%.bbappend \
    /meta-freescale/recipes-graphics/cairo \
"

# machines where Torizon is experimental
EXPERIMENTALOVERRIDES = ""
# Currently Torizon does not support any experimental machines, in future such machines can be added like below:
#EXPERIMENTALOVERRIDES:colibri-imx6ull = ":experimental"
DISTROOVERRIDES .= "${EXPERIMENTALOVERRIDES}"

# Use our variant of the aktualizr client instead of the
# default from meta-updater
PREFERRED_PROVIDER_aktualizr = "aktualizr-torizon"
PREFERRED_PROVIDER_aktualizr-native = "aktualizr-torizon-native"
PREFERRED_RPROVIDER_aktualizr = "aktualizr-torizon"
PREFERRED_RPROVIDER_aktualizr-info = "aktualizr-torizon"
PREFERRED_RPROVIDER_aktualizr-shared-prov = "aktualizr-torizon"

# disable warning message from meta-security
SKIP_META_SECURITY_SANITY_CHECK = "1"

# Configure the "kernel command-line protection" for Torizon OS (relevant when
# the tdx-signed class is in use).
TOS_SECBOOT_REQUIRED_BOOTARGS_COMMON ?= "root=LABEL=otaroot rootfstype=ext4 ${OSTREE_KERNEL_ARGS}"
TOS_SECBOOT_REQUIRED_BOOTARGS ?= "${TOS_SECBOOT_REQUIRED_BOOTARGS_COMMON}"
TOS_SECBOOT_REQUIRED_BOOTARGS:apalis-imx6 ?= "enable_wait_mode=off vmalloc=400M ${TOS_SECBOOT_REQUIRED_BOOTARGS_COMMON}"
TOS_SECBOOT_REQUIRED_BOOTARGS:colibri-imx6 ?= "enable_wait_mode=off galcore.contiguousSize=50331648 ${TOS_SECBOOT_REQUIRED_BOOTARGS_COMMON}"
TOS_SECBOOT_REQUIRED_BOOTARGS:colibri-imx6ull-emmc ?= "user_debug=30 ${TOS_SECBOOT_REQUIRED_BOOTARGS_COMMON}"
TOS_SECBOOT_REQUIRED_BOOTARGS:qemuarm64 ?= ""
# Override BSP configuration:
TDX_SECBOOT_REQUIRED_BOOTARGS:tdx-signed = "${TOS_SECBOOT_REQUIRED_BOOTARGS}"
```

## conf/distro/include/versioning.inc
```bitbake
TDX_BUILDNBR ?= "0"
TDX_PURPOSE ?= "Testing"

TDX_MAJOR ?= "7"
TDX_MINOR ?= "0"
TDX_PATCH ?= "0"

def get_tdx_prerelease(purpose, datetime):
    if purpose == "Testing":
        return '-devel-%s' % (datetime)
    elif purpose == "Nightly":
        return '-devel-%s' % (datetime[:8])
    elif purpose == "Monthly":
        return '-devel-%s' % (datetime[:6])
    elif purpose == "Release":
        return ''
    else:
        return '-devel-%s' % (datetime)

TDX_BUILD ?= "+build.${TDX_BUILDNBR}"
TDX_MATRIX_BUILD_TIME ?= "${DATETIME}"
TDX_MATRIX_BUILD_TIME[vardepsexclude] = "DATETIME"
TDX_PRERELEASE ?= "${@get_tdx_prerelease(d.getVar('TDX_PURPOSE'), d.getVar('TDX_MATRIX_BUILD_TIME'))}"
TDX_RELEASE ?= "${TDX_MAJOR}.${TDX_MINOR}.${TDX_PATCH}"

# Toradex Version number without date for U-Boot/Kernel and other Toradex
# specific software artifacts.
TDX_VERSION ?= "${TDX_RELEASE}${@'' if d.getVar('TDX_PURPOSE') == 'Release' else '-devel'}"

# Complete image version with date and build number
DISTRO_VERSION = "${TDX_RELEASE}${TDX_PRERELEASE}${TDX_BUILD}"
IMAGE_VERSION_SUFFIX = "-${DISTRO_VERSION}"
```

## conf/distro/include/xenomai.inc
```bitbake
# Xenomai config

XENOMAI_KERNEL_ARGS = "audit=0 clocksource=arch_sys_counter nohz_full=1,3 \
                       irqaffinity=0 isolcpus=1,3 rcu_nocbs=1,3 rcu_nocb_poll=1024 \
                       nosoftlockup numa_balancing=disable hugepages=1024 "
OSTREE_KERNEL_ARGS:sota:append:verdin-imx8mp:xenomai4 = " ${XENOMAI_KERNEL_ARGS} "
OSTREE_KERNEL_ARGS:sota:append:verdin-imx8mp:xenomai3 = " ${XENOMAI_KERNEL_ARGS} "

PREFERRED_PROVIDER_virtual/kernel:xenomai4:upstream = "linux-xenomai-4"
PREFERRED_PROVIDER_virtual/dtb:xenomai4:upstream = "device-tree-overlays-mainline"
LINUX_VERSION_EXTENSION:xenomai4:upstream ?= "-torizon-${LINUX_KERNEL_TYPE}-xenomai4"

PREFERRED_PROVIDER_virtual/kernel:xenomai3:upstream = "linux-xenomai-3"
PREFERRED_PROVIDER_virtual/dtb:xenomai3:upstream = "device-tree-overlays-mainline"
LINUX_VERSION_EXTENSION:xenomai3:upstream ?= "-torizon-${LINUX_KERNEL_TYPE}-xenomai3"

# This is required to build the upstream device trees
IMX_DEFAULT_BSP:xenomai4:upstream = "mainline"
IMX_DEFAULT_BSP:xenomai3:upstream = "mainline"
```

## conf/distro/torizon-rt.conf
```bitbake
require conf/distro/torizon.conf

DISTRO = "torizon-rt"
DISTRO_NAME = "Torizon OS with PREEMPT_RT"

DISTRO_FLAVOUR = " (PREEMPT_RT)"
DISTRO_FLAVOUR:experimental = " (PREEMPT_RT EXPERIMENTAL)"

DISTROOVERRIDES .= ":preempt-rt"

IMAGE_BASENAME_SUFFIX = "-rt"
```

## conf/distro/torizon-upstream-rt.conf
```bitbake
require conf/distro/torizon-rt.conf

DISTRO = "torizon-upstream-rt"
DISTRO_NAME = "Torizon OS Upstream with PREEMPT_RT"

DISTRO_FLAVOUR = " (UPSTREAM PREEMPT_RT)"
DISTRO_FLAVOUR:experimental = " (UPSTREAM PREEMPT_RT EXPERIMENTAL)"

DISTROOVERRIDES .= ":upstream"
```

## conf/distro/torizon-upstream-xenomai3.conf
```bitbake
require conf/distro/torizon.conf
require conf/distro/include/xenomai.inc

DISTRO = "torizon-upstream-xenomai3"
DISTRO_NAME = "Torizon OS Upstream with Xenomai 3"

DISTRO_FLAVOUR = " (UPSTREAM XENOMAI3)"
DISTRO_FLAVOUR:experimental = " (UPSTREAM XENOMAI3 EXPERIMENTAL)"

DISTROOVERRIDES .= ":xenomai3:upstream"

IMAGE_BASENAME_SUFFIX = "-xenomai3"
```

## conf/distro/torizon-upstream-xenomai4.conf
```bitbake
require conf/distro/torizon.conf
require conf/distro/include/xenomai.inc

DISTRO = "torizon-upstream-xenomai4"
DISTRO_NAME = "Torizon OS Upstream with Xenomai 4"

DISTRO_FLAVOUR = " (UPSTREAM XENOMAI4)"
DISTRO_FLAVOUR:experimental = " (UPSTREAM XENOMAI4 EXPERIMENTAL)"

DISTROOVERRIDES .= ":xenomai4:upstream"

IMAGE_BASENAME_SUFFIX = "-xenomai4"
```

## conf/distro/torizon-upstream.conf
```bitbake
require conf/distro/torizon.conf

DISTRO = "torizon-upstream"
DISTRO_NAME = "Torizon OS Upstream"

DISTRO_FLAVOUR = " (UPSTREAM)"
DISTRO_FLAVOUR:experimental = " (UPSTREAM EXPERIMENTAL)"

DISTROOVERRIDES .= ":upstream"
```

## conf/distro/torizon.conf
```bitbake
require conf/distro/include/torizon.inc
require conf/distro/sota.conf.inc

DISTRO = "torizon"
DISTRO_NAME = "Torizon OS"

DISTRO_FLAVOUR:experimental = " (EXPERIMENTAL)"
```

## conf/layer.conf
```bitbake
# We might have a conf and classes directory, append to BBPATH
BBPATH .= ":${LAYERDIR}"

# We have a recipes directory, add to BBFILES
BBFILES += "${LAYERDIR}/recipes*/*/*.bb ${LAYERDIR}/recipes*/*/*.bbappend"

BBFILE_COLLECTIONS += "meta-toradex-torizon"
BBFILE_PATTERN_meta-toradex-torizon := "^${LAYERDIR}/"
BBFILE_PRIORITY_meta-toradex-torizon = "90"

LAYERDEPENDS_meta-toradex-torizon = "sota virtualization-layer"
LAYERSERIES_COMPAT_meta-toradex-torizon = "scarthgap styhead"

BBFILES_DYNAMIC += "\
    fsl-bsp-release:${LAYERDIR}/dynamic-layers/meta-imx-bsp/*/*/*.bb \
    fsl-bsp-release:${LAYERDIR}/dynamic-layers/meta-imx-bsp/*/*/*.bbappend \
    intel:${LAYERDIR}/dynamic-layers/meta-intel/*/*/*.bb \
    intel:${LAYERDIR}/dynamic-layers/meta-intel/*/*/*.bbappend \
    meta-rz-bsp:${LAYERDIR}/dynamic-layers/meta-rz-bsp/*/*/*.bb \
    meta-rz-bsp:${LAYERDIR}/dynamic-layers/meta-rz-bsp/*/*/*.bbappend \
    meta-ti-bsp:${LAYERDIR}/dynamic-layers/meta-ti-bsp/*/*/*.bb \
    meta-ti-bsp:${LAYERDIR}/dynamic-layers/meta-ti-bsp/*/*/*.bbappend \
    toradex-bsp-common-layer:${LAYERDIR}/dynamic-layers/meta-toradex-bsp-common/*/*/*.bb \
    toradex-bsp-common-layer:${LAYERDIR}/dynamic-layers/meta-toradex-bsp-common/*/*/*.bbappend \
    toradex-ti-layer:${LAYERDIR}/dynamic-layers/meta-toradex-ti/*/*/*.bb \
    toradex-ti-layer:${LAYERDIR}/dynamic-layers/meta-toradex-ti/*/*/*.bbappend \
"
```

## conf/machine/include/am62lxx-evm.inc
```bitbake
require common-am62xx.inc

TORIZON_TTY_DEVICE = "ttyS0,115200"

UENV_EXTRA_CONFIGS = "if test "${board_name}" = "am62lx" -a "${fdtfile}" = "ti/k3-am62l3-evm.dtb"; then env set fdtfile k3-am62l3-evm.dtb; fi"

OSTREE_DEVICETREE = "\
    ti/k3-am62l3-evm.dtb \
    ti/k3-am62l3-evm-lpmdemo.dtb \
    ti/k3-am62l3-evm-m2-cc3351.dtbo \
    ti/k3-am62l3-evm-pwm.dtbo \
    ti/k3-am62l3-evm-dsi-rpi-7inch-panel.dtbo \
"
```
