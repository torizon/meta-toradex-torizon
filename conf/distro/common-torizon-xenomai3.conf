## conf/machine/include/am62pxx-evm.inc
```bitbake
require common-am62xx.inc

CORE_IMAGE_BASE_INSTALL:append:am62pxx = " ti-img-rogue-driver"

UENV_EXTRA_CONFIGS:am62pxx-evm = "if test "${board_name}" = "am62px" -a "${fdtfile}" = "ti/k3-am62p5-sk.dtb"; then env set fdtfile k3-am62p5-sk.dtb; echo DONE; fi"

# If there are any DT overlays in OSTREE_DEVICETREE that should be automatically applied during
# boot, set them in OSTREE_DEVICETREE_OVERLAY_BOOT, similar to the example below:
# OSTREE_DEVICETREE_OVERLAY_BOOT:am62pxx-evm = " \
#     k3-am62x-sk-csi2-imx219.dtbo \
#     k3-am62x-sk-csi2-ov5640.dtbo \
#     k3-am62x-sk-csi2-tevi-ov5640.dtbo \
#     k3-am62x-sk-hdmi-audio.dtbo \
# "

IMAGE_BOOT_FILES:append:am62pxx-evm = " tiboot3-am62px-hs-fs-evm.bin"
```

## conf/machine/include/am62xx-evm.inc
```bitbake
require common-am62xx.inc

UENV_EXTRA_CONFIGS = "if test "${board_name}" = "am62b_p1_skevm" -a "${fdtfile}" = "ti/k3-am625-sk.dtb"; then env set fdtfile k3-am625-sk.dtb; fi"

KERNEL_DEVICETREE = " \
    ti/k3-am625-sk.dtb \
    ti/k3-am62x-sk-csi2-imx219.dtbo \
    ti/k3-am62x-sk-csi2-ov5640.dtbo \
    ti/k3-am62x-sk-csi2-tevi-ov5640.dtbo \
    ti/k3-am62x-sk-hdmi-audio.dtbo \
"
# If there are any DT overlays in OSTREE_DEVICETREE that should be automatically applied during
# boot, set them in OSTREE_DEVICETREE_OVERLAY_BOOT, similar to the example below:
# OSTREE_DEVICETREE_OVERLAY_BOOT = " \
#     k3-am62x-sk-csi2-imx219.dtbo \
#     k3-am62x-sk-csi2-ov5640.dtbo \
#     k3-am62x-sk-csi2-tevi-ov5640.dtbo \
#     k3-am62x-sk-hdmi-audio.dtbo \
# "

IMAGE_BOOT_FILES:append = " tiboot3-am62x-hs-fs-evm.bin tiboot3-am62x-gp-evm.bin tiboot3-am62x-hs-evm.bin"
```

## conf/machine/include/beagley-ai.inc
```bitbake
WKS_FILE:sota:beagley-ai = "torizon-am62xx-sota.wks"

OSTREE_KERNEL_ARGS:sota:beagley-ai = "quiet logo.nologo vt.global_cursor_default=0 plymouth.ignore-serial-consoles splash fbcon=map:10 console=ttyS2,115200 root=LABEL=otaroot rootfstype=ext4"

CORE_IMAGE_BASE_INSTALL:append:beagley-ai = " ti-img-rogue-driver"

UBOOT_BOOT_PARTITION_NUMBER:beagley-ai = "2"
OTAROOT_PARTITION_NUMBER:beagley-ai = "2"

IMAGE_FSTYPES:append = " wic"
IMAGE_BOOT_FILES:append:beagley-ai = " tispl.bin u-boot.img tiboot3.bin tiboot3-j722s-hs-fs-evm.bin"

PREFERRED_PROVIDER_virtual/dtb = ""
hostname:pn-base-files = "beagley-ai"
```

## conf/machine/include/common-am62xx.inc
```bitbake
# Base configurations for TI's BSP AM62 devices

# Adding custom override to differentiate between Verdin AM62 and TI's AM62xx EVMs
MACHINEOVERRIDES =. "common-ti:"

WKS_FILE:sota = "torizon-am62xx-sota.wks"

TORIZON_TTY_DEVICE ?= "ttyS2,115200"
OSTREE_KERNEL_ARGS:sota = "quiet logo.nologo vt.global_cursor_default=0 plymouth.ignore-serial-consoles splash fbcon=map:10 console=${TORIZON_TTY_DEVICE} root=LABEL=otaroot rootfstype=ext4"

UBOOT_BOOT_PARTITION_NUMBER = "2"
OTAROOT_PARTITION_NUMBER = "2"

IMAGE_FSTYPES:append = " wic"
IMAGE_BOOT_FILES:append = " tispl.bin u-boot.img tiboot3.bin"

PREFERRED_PROVIDER_virtual/dtb = ""
```

## conf/machine/include/common-mtk.inc
```bitbake
# Shared Torizon <-> MediaTek BSP integration glue for Genio 1200 (MT8395)
# machines provided by meta-adlink-mtk / meta-mediatek-bsp.

# --- GPU userspace ----------------------------------------------------------
# The BSP (mt8195.inc) defaults to the proprietary Mali DDK r48. Uncomment to
# switch to the open-source Panfrost/Mesa stack (overrides the BSP's ?= defaults).
#PREFERRED_PROVIDER_virtual/egl      = "mesa"
#PREFERRED_PROVIDER_virtual/libegl   = "mesa"
#PREFERRED_PROVIDER_virtual/libgbm   = "mesa"
#PREFERRED_PROVIDER_virtual/libgl    = "mesa"
#PREFERRED_PROVIDER_virtual/libgles1 = "mesa"
#PREFERRED_PROVIDER_virtual/libgles2 = "mesa"
#PREFERRED_PROVIDER_virtual/libgles3 = "mesa"
#PREFERRED_PROVIDER_virtual/mesa     = "mesa"

# --- OTA / U-Boot environment -----------------------------------------------
# Use libubootenv for OTA env access, as on other Torizon BSPs.
PREFERRED_PROVIDER_u-boot-fw-utils = "libubootenv"
PREFERRED_RPROVIDER_u-boot-fw-utils = "libubootenv"

# --- OSTree -> U-Boot boot integration --------------------------------------
# Boot the stock Torizon way: distro_bootcmd scans storage, sources /boot.scr,
# which imports the OSTree-managed /boot/loader/uEnv.txt and runs bootcmd_run.
# u-boot-distro-boot provides boot.scr and the base uEnv.txt; this PREFERRED_-
# PROVIDER also triggers the ostree bbappend to install ostree-uboot-env.
PREFERRED_PROVIDER_u-boot-default-script = "u-boot-distro-boot"

# Torizon's u-boot-fuse.inc appends i.MX-only HAB patches that fail do_patch on
# the MediaTek u-boot. Disable them for this non-i.MX machine.
TDX_UBOOT_FUSE_PATCHES:lec-mtk1200 = ""

# Native deps the vendor recipes omit: u-boot's mkeficapsule needs gnutls/libuuid,
# TF-A's fiptool/bl2 need libcrypto; otherwise do_compile fails to find them.
DEPENDS:append:pn-u-boot = " gnutls-native util-linux-native"
DEPENDS:append:pn-trusted-firmware-a = " openssl-native"
DEPENDS:append:pn-bl2 = " openssl-native"

# Bootable partition is resolved at runtime by the distro scan (rootfs is marked
# --active in the wks, and is not partition #1). Thread ${distro_bootpart} into
# boot.scr and otaroot instead of hardcoding the index.
UBOOT_BOOT_PARTITION_NUMBER = "${distro_bootpart}"
# fitImage conf node is conf-<KERNEL_DEVICETREE, '/'->'_'>; point fdtfile/fdt_file at it.
FITIMAGE_CONF_NODE = "${@d.getVar('KERNEL_DEVICETREE').split()[0].replace('/', '_')}"
UENV_EXTRA_CONFIGS = "env set otaroot ${distro_bootpart} ; env set fdtfile ${FITIMAGE_CONF_NODE} ; env set fdt_file ${FITIMAGE_CONF_NODE}"

# Device tree deployed into the OSTree boot directory.
OSTREE_DEVICETREE ?= "mediatek/lec-mtk-i1200-ufs.dtb"

# --- OP-TEE userspace -------------------------------------------------------
# tee-supplicant; not pulled in by the BSP, so install it explicitly.
IMAGE_INSTALL:append = " optee-client"

# --- DRAM calibration (libdram) ---------------------------------------------
# Without the MediaTek NDA, TF-A links prebuilt libdram, which ships only a
# "genio-1200-evk" config (no "-ufs"). Use it for the prebuilt path, keep the
# -ufs name for the NDA source build. This is ADLINK's own vendor default for
# the module (meta-adlink-mtk's lec-mtk-i1200-ufs.conf sets the same).
LIBDRAM_BOARD_NAME:lec-mtk1200 = "${@bb.utils.contains('DISTRO_FEATURES', 'nda-mtk', 'genio-1200-evk-ufs', 'genio-1200-evk', d)}"

# --- Image / flash integration ----------------------------------------------
# Torizon OSTree layout: FIP bootloader + single ext4 OSTree sysroot, no /boot
# partition. The vendor mediatek-bootimg.wks fails do_image_wic once
# IMAGE_BOOT_FILES is empty, so use the OSTree wks (matches the genio-flash
# partition table: bootloaders + rootfs).
WKS_FILE:sota = "torizon-mtk-sota.wks"

# Mask meta-adlink-mtk bbappends for recipes provided only by meta-rity and
# board-assets, which Torizon does not use.
BBMASK += "meta-adlink-mtk/recipes-rity/"
BBMASK += "meta-adlink-mtk/recipes-core/board-assets/"
```

## conf/machine/include/common-stm32mp.inc
```bitbake
PREFERRED_PROVIDER_virtual/dtb = ""

# NOTE: disable ST images not required for Torizon
ST_BOOTFS:stm32mpcommon   ?= "0"
ST_VENDORFS:stm32mpcommon ?= "0"
ST_USERFS:stm32mpcommon   ?= "0"

# NOTE: remove dependency on userfs since we don't build it
WKS_FILE_DEPENDS:remove:stm32mpcommon = "st-image-userfs"

# STM32MP bootargs to enable UART console
OSTREE_KERNEL_ARGS:stm32mpcommon = "earlyprintk earlycon console=ttySTM0,115200"

# Use ota-ext4 image instead of default ext4 for rootfs and mark the rootfs partition as System.
# Note that rootfs is the only filesystem image to be installed since STM32MP's bootfs, vendorfs and
# userfs images are disabled in the Torizon, so it is ok to change the common suffix.
PARTITIONS_SUFFIX = "ota-ext4"
PARTITIONS_IMAGES[rootfs] = "${STM32MP_ROOTFS_IMAGE},${STM32MP_ROOTFS_LABEL},,${STM32MP_ROOTFS_SIZE},System"

PREFERRED_PROVIDER_u-boot-default-script = "u-boot-distro-boot"
UBOOT_BOOT_PARTITION_NUMBER = "${distro_bootpart}"
UENV_EXTRA_CONFIGS = "env set otaroot ${distro_bootpart}"
KERNEL_BOOTCMD:stm32mp1common = "bootm"

IMAGE_ROOTFS_MAXSIZE = "2500000"

def partImage2partConfig_trz(d, config, fstype=None):
    """
    Convert PARTTIONS_IMAGES['config'] setting format to format expected to feed
    PARTITIONS_CONFIG[xxx].
    Manage <image_name> update respect to 'fstype' provided and apply the rootfs
    namming or standard partition image one.
        FROM: <image_name>,<partition_label>,<mountpoint>,<size>,<type>
        TO  : <binary_name>,<partition_label>,<size>,<type>
    """
    items = d.getVarFlag('PARTITIONS_IMAGES', config).split(',') or ""
    if len(items) != 5:
        bb.fatal('[partImage2partConfig] Wrong settings for PARTTIONS_IMAGES[%s] : %s' % (config, items))
    overrides = d.getVar('OVERRIDES')
    if items[2] == '' and 'openstlinuxcommon' not in overrides.split(':'):
        bin_suffix = '-${MACHINE}'
    else:
        bin_suffix = '-${DISTRO}-${MACHINE}'
    if fstype:
        bin_name = items[0] + bin_suffix + '.' + fstype
    else:
        bin_name = items[0] + bin_suffix
    # Set string for PARTITIONS_CONFIG item: <binary_name>,<partlabel>,<size>,<type>
    part_format = bin_name + ',' + items[1] + ',' + items[3] + ',' + items[4]
    return part_format

PARTITIONS_CONFIG[emmc] = "\
    ${@' '.join(['%s' % partImage2partConfig_trz(d, config, '${PARTITIONS_SUFFIX}') for config in d.getVar('PARTITIONS_LIST').split()])} \
    "
PARTITIONS_CONFIG[sdcard] = "\
    ${@' '.join(['%s' % partImage2partConfig_trz(d, config, '${PARTITIONS_SUFFIX}') for config in d.getVar('PARTITIONS_LIST').split()])} \
    "

# Disable resize-helper since it unsets the bootable flag from the rootfs partition,
# which leads to U-Boot can't find bootable images on the STM32MP targets
CORE_IMAGE_BASE_INSTALL:remove:stm32mpcommon = " \
    resize-helper \
"
```

## conf/machine/include/genericx86-64.inc
```bitbake
WKS_FILE:sota:genericx86-64 = "efidisk-sota.wks"
WKS_FILE_DEPENDS:remove = "tezi-metadata virtual/dtb"
WKS_FILE_DEPENDS:append = " ovmf"

OSTREE_KERNEL_ARGS:genericx86-64 = "quiet logo.nologo plymouth.ignore-serial-consoles splash console=ttyS0,115200 root=LABEL=otaroot rootfstype=ext4"
OSTREE_BOOTLOADER:genericx86-64 = "grub"
OSTREE_DEPLOY_DEVICETREE:genericx86-64 = "0"
EFI_PROVIDER:genericx86-64 = "grub-efi"
SOTA_CLIENT_FEATURES:remove = "ubootenv"

IMAGE_FSTYPES_REMOVE = "hddimg teziimg"
IMAGE_FSTYPES:append = " wic.vmdk wic.vdi"

QB_DRIVE_TYPE = "/dev/hd"
QB_DEFAULT_FSTYPE = "wic"
QB_MEM:genericx86-64 = "-m 2048"

PACKAGECONFIG:append:pn-qemu-system-native = " sdl"
PACKAGECONFIG:append:pn-nativesdk-qemu = " sdl"

NET_NAME:pn-networkmanager = "enp"
NET_NUMS:pn-networkmanager = "0"

PREFERRED_PROVIDER_u-boot-default-script = ""
PREFERRED_PROVIDER_virtual/dtb = ""
```

## conf/machine/include/imx93frdm.inc
```bitbake
WKS_FILE:sota = "torizon-imx93frdm-sota.wks"

OSTREE_KERNEL_ARGS:sota:imx:append = "console=ttyLP0,115200 earlycon root=LABEL=otaroot rootfstype=ext4"

UENV_EXTRA_CONFIGS = "env set ramdisk_addr_r "${initrd_addr}""

UBOOT_BOOT_PARTITION_NUMBER = "1"
OTAROOT_PARTITION_NUMBER = "1"

PREFERRED_PROVIDER_virtual/dtb = ""
PREFERRED_PROVIDER_u-boot-default-script = "u-boot-distro-boot"

# Lock the BSP recipes to the versions used by the upstream FRDM support.
# This may be removed if/when meta-imx-frdm is updated to work with the
# same manifest as Torizon
SRCREV:pn-u-boot-imx = "de16f4f17221b2ff72b8cb18c28cd8a29f3c2710"
SRCREV:pn-linux-imx = "d23d64eea5111e1607efcce1d601834fceec92cb"
LINUX_VERSION:pn-linux-imx = "6.6.36"
```

## conf/machine/include/imx95-19x19-verdin.inc
```bitbake
WKS_FILE:sota = "torizon-imx95-sota.wks"

OSTREE_KERNEL_ARGS:sota:imx:append = "console=ttyLP0,115200 earlycon root=LABEL=otaroot rootfstype=ext4"

UENV_EXTRA_CONFIGS = "env set ramdisk_addr_r "${initrd_addr}""

UBOOT_BOOT_PARTITION_NUMBER = "1"
OTAROOT_PARTITION_NUMBER = "1"

PREFERRED_PROVIDER_virtual/dtb = ""
PREFERRED_PROVIDER_u-boot-default-script = "u-boot-distro-boot"
```
