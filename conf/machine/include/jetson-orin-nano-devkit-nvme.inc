## conf/machine/include/jetson-orin-nano-devkit-nvme.inc
```bitbake
require jetson-orin-nano-devkit.inc

TNSPEC_BOOTDEV = "nvme0n1p1"

PARTITION_LAYOUT_TEMPLATE = "flash_t234_qspi_nvme.xml"

PARTITION_LAYOUT_TEMPLATE_DEFAULT_SUPPORTS_REDUNDANT = "0"
```

## conf/machine/include/jetson-orin-nano-devkit.inc
```bitbake
TEGRA_ESSENTIAL_EXTRA_RDEPENDS:remove =  " \
  l4t-launcher-extlinux \
"

OSTREE_KERNEL_ARGS:append = " mminit_loglevel=4 console=ttyTCU0,115200 firmware_class.path=/etc/firmware nospectre_bhb console=tty0 root=/dev/${TNSPEC_BOOTDEV} rootfstype=ext4 rootwait"

IMAGE_TEGRAFLASH_KERNEL = "${DEPLOY_DIR_IMAGE}/tegra-minimal-initramfs-${MACHINE}.cboot"
IMAGE_TEGRAFLASH_FS_TYPE = "ota-ext4"

BBMASK += "meta-tegra/external/sota/recipes-bsp/uefi/edk2-firmware-tegra_%.bbappend"

do_image_tegraflash[depends] += " tegra-minimal-initramfs:do_image_complete"

MACHINE_EXTRA_RDEPENDS:remove = " tegra-redundant-boot"
```

## conf/machine/include/qemuarm64.inc
```bitbake
UBOOT_MACHINE = "qemu_arm64_defconfig"
UBOOT_ENTRYPOINT = "0x40080000"

WKS_FILE_DEPENDS:remove = "tezi-metadata virtual/dtb"
WKS_FILE:sota:qemuarm64 = "torizon-sota.wks"

OSTREE_KERNEL_ARGS:qemuarm64 = "quiet logo.nologo plymouth.ignore-serial-consoles splash console=ttyAMA0 root=LABEL=otaroot rootfstype=ext4"
OSTREE_DEPLOY_DEVICETREE:qemuarm64 = "0"

QB_MACHINE = "-machine virt"
QB_DRIVE_TYPE = "/dev/vda"
QB_DEFAULT_FSTYPE = "wic"
QB_MEM:qemuarm64 = "-m 1057"
QB_OPT_APPEND:qemuarm64 = "-device qemu-xhci -device usb-tablet -device usb-kbd -no-acpi -bios ${DEPLOY_DIR_IMAGE}/u-boot.bin -d unimp -semihosting-config enable=on,target=native"

IMAGE_FSTYPES_REMOVE = "tar.bz2 ext4 teziimg"
IMAGE_FSTYPES:append = " wic"

PACKAGECONFIG:append:pn-qemu-system-native = " sdl"
PACKAGECONFIG:append:pn-nativesdk-qemu = " sdl"

NET_NAME:pn-networkmanager = "enp"
NET_NUMS:pn-networkmanager = "0"

PREFERRED_PROVIDER_virtual/dtb = ""

PREFERRED_PROVIDER_virtual/bootloader = "u-boot"
PREFERRED_PROVIDER_virtual/kernel:qemuarm64 = "linux-yocto"
PREFERRED_PROVIDER_virtual/kernel:qemuarm64:preempt-rt = "linux-yocto-rt"

PREFERRED_PROVIDER_u-boot-default-script:qemuarm64 = "u-boot-distro-boot"
```

## conf/machine/include/smarc-rzv2l.inc
```bitbake
OSTREE_KERNEL_ARGS:sota:append = "console=ttySC0,115200 earlycon root=LABEL=otaroot rootfstype=ext4"

DISTRO_FEATURES += " acl debuginfod ext2 ipv4 ipv6 usbgadget usbhost wifi xattr nfs zeroconf pci vfat seccomp"

PREFERRED_PROVIDER_u-boot-fw-utils = "libubootenv"
PREFERRED_RPROVIDER_u-boot-fw-utils = "libubootenv"
PREFERRED_PROVIDER_u-boot-default-script = "u-boot-distro-boot"
PREFERRED_PROVIDER_u-boot-default-script:sota = "u-boot-distro-boot"
IMAGE_BOOT_FILES:append = " boot.scr-${MACHINE};boot.scr"
WKS_FILE_DEPENDS:append = " u-boot-default-script"

hostname:pn-base-files = "torizon-rzv2l"

PREFERRED_PROVIDER_virtual/dtb = ""
```

## conf/machine/include/stm32mp25-disco.inc
```bitbake
require common-stm32mp.inc

hostname:pn-base-files = "torizon-stm32mp25-disco"

# Enable build eMMC images for the Disco target
BOOTDEVICE_LABELS:append:stm32mp25-disco = " emmc"
STM32MP_DT_FILES_EMMC:stm32mp25-disco    += "stm32mp257f-dk"
```

## conf/machine/luna-sl1680.conf
```bitbake
# Base configuration for the Luna SL1680 board
require conf/machine/sl1680.conf
require conf/machine/include/sl1680.inc

MACHINEOVERRIDES =. "sl1680:"
MACHINEOVERRIDES:class-native =. "luna-sl1680:"

hostname:pn-base-files = "torizon-luna-sl1680"
```

## conf/machine/winglet.conf
```bitbake
# Base configuration for the SL1680 Winglet board
require conf/machine/sl1680.conf
require conf/machine/include/sl1680.inc

MACHINEOVERRIDES =. "sl1680:"
MACHINEOVERRIDES:class-native =. "winglet:"

hostname:pn-base-files = "torizon-winglet"
```

## scripts/lib/wic/canned-wks/efiimage-sota.wks
```
# short-description: Create an OTA-enabled EFI disk image
# long-description: Creates an OTA-enabled EFI disk image that the user
# can directly dd to boot media.

part /boot --source bootimg-efi-tmp --sourceparams="loader=grub-efi" --ondisk hda --label efi --active --align 1024
part / --source otaimage --ondisk hda --fstype=ext4 --align 1024 --use-uuid

bootloader --ptable gpt --timeout=0 --append="rootfstype=ext4 console=ttyS0,115200 console=tty0" --configfile="grub-ota.cfg"
```

## scripts/lib/wic/canned-wks/torizon-am62xx-sota.wks
```
# short-description: Create OTA-enabled SD card image
# long-description: Creates a partitioned SD card image with OSTree
# physical sysroot as a payload. Boot files are located in the
# first vfat partition.
# Based on:
# meta-ti/meta-ti-bsp/wic/sdimage-2part.wks
# meta-updater/scripts/lib/wic/canned-wks/sdimage-sota.wks

part --source bootimg-partition --fstype=vfat --label boot --active --align 1024 --use-uuid --fixed-size 128M
part / --source otaimage --ondisk mmcblk --fstype=ext4 --align 1024
```

## scripts/lib/wic/canned-wks/torizon-imx95-sota.wks
```
# short-description: Create OTA-enabled SD card image
# long-description: Creates a partitioned SD card image with OSTree
# physical sysroot as a payload. Boot files are located in the
# first vfat partition.
part u-boot --source rawcopy --sourceparams="file=imx-boot.tagged" --ondisk mmcblk --no-table --align 32
part / --source otaimage --ondisk mmcblk --fstype=ext4 --align 8192
```

## scripts/lib/wic/canned-wks/torizon-mtk-sota.wks
```
# short-description: OTA-enabled OSTree image for MediaTek Genio (bootloader + single rootfs)
# long-description: GPT image for the genio-flash flow in Torizon's OSTree layout:
# a raw FIP bootloader partition plus a single ext4 partition carrying the OSTree
# sysroot (no /boot partition - kernel/DTB/initramfs live in the OSTree deployment).
# Matches the genio-flash partition table (rity.json: "bootloaders" + "rootfs").
# Reworked from meta-mediatek-bsp mediatek-bootimg.wks, keeping the "bootloaders"
# partition identical so BL2's FIP lookup is unaffected.

bootloader --ptable gpt --timeout=0
part --source rawcopy --sourceparams="file=fip.bin" --part-name bootloaders --align 512 --fixed-size 4M
# --active marks the rootfs bootable; the distro_bootcmd scan keys off that flag,
# not the partition index, so the rootfs is found here at partition 2.
part / --source otaimage --fstype=ext4 --part-name rootfs --align 4096 --use-uuid --active
```

## scripts/lib/wic/canned-wks/torizon-sota.wks
```
# short-description: Create OTA-enabled raw image of Torizon OS
# long-description: Create a single partition raw image with OSTree
# physical sysroot as a payload.

part / --source otaimage --ondisk mmcblk --fstype=ext4 --align 4096
```
